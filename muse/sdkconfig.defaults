## muse/sdkconfig.defaults
```kconfig
CONFIG_IDF_TARGET="esp32c3"
CONFIG_PARTITION_TABLE_OFFSET=0x8000
CONFIG_PARTITION_TABLE_CUSTOM=y
CONFIG_PARTITION_TABLE_CUSTOM_FILENAME="../partitions.csv"
CONFIG_ESPTOOLPY_FLASHSIZE_8MB=y
CONFIG_ESPTOOLPY_HEADER_FLASHSIZE_UPDATE=n
CONFIG_SECURE_SIGNED_APPS_NO_SECURE_BOOT=n
CONFIG_SECURE_SIGNED_ON_UPDATE_NO_SECURE_BOOT=n
CONFIG_SECURE_BOOT_BUILD_SIGNED_BINARIES=n
CONFIG_SECURE_BOOT=n
CONFIG_FLASH_ENCRYPTION_ENABLED=n
CONFIG_NVS_ENCRYPTION=n
CONFIG_HOMEHUB_NVS_ENCRYPTION=n
CONFIG_HOMEHUB_PAIRING_EFUSE_AUTH=n
CONFIG_HOMEHUB_OTA_ENABLED=n
CONFIG_HOMEHUB_TUNNEL=n
CONFIG_HOMEHUB_DISPLAY_COMMANDS=n
CONFIG_MUSE_HATCH=n
CONFIG_MUSE_VIDEO=n
CONFIG_PM_ENABLE=n
CONFIG_GADGET_PRODUCT_NAME="Passport Muse"
CONFIG_HOMEHUB_BLE_NAME_PREFIX="MuseGadget"
CONFIG_LV_COLOR_DEPTH_16=y
CONFIG_LV_USE_QRCODE=y
CONFIG_LV_FONT_FMT_TXT_LARGE=y
CONFIG_LV_FONT_MONTSERRAT_14=y
CONFIG_LV_FONT_MONTSERRAT_20=y
CONFIG_LV_FONT_MONTSERRAT_28=y
CONFIG_LV_DEF_REFR_PERIOD=40
CONFIG_ESP_CONSOLE_USB_SERIAL_JTAG=y
CONFIG_ESP_CONSOLE_SECONDARY_NONE=y
CONFIG_FREERTOS_HZ=1000
CONFIG_COMPILER_OPTIMIZATION_SIZE=y
CONFIG_LWIP_SNTP_MAX_SERVERS=3
```
